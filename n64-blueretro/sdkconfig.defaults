## n64-blueretro/sdkconfig.defaults
```kconfig
#
# BluControl SDK Configuration
#
CONFIG_BLUCONTROL_MODE_LENGTH=2
CONFIG_BLUCONTROL_MODE1_LED_GPIO=16
CONFIG_BLUCONTROL_MODE2_LED_GPIO=-1
CONFIG_BLUCONTROL_SECONDS_FOR_SWITCH_MODE=5
CONFIG_BLUCONTROL_SWITCH_BUTTONS_LENGTH=3
CONFIG_BLUCONTROL_SWITCH_BUTTON1_GPIO=23
CONFIG_BLUCONTROL_SWITCH_BUTTON2_GPIO=21
CONFIG_BLUCONTROL_SWITCH_BUTTON3_GPIO=18
# end of BluControl SDK Configuration
```

## n64-sdk/n64-components/Kconfig
```kconfig
menu "BluN64 Configuration"

    choice BLUN64_PINOUT_TYPE
        prompt "Pinout type"
        default BLUN64_PINOUT_TYPE_ORIGINAL
        help
            Select which pinout will you use. For reference, the original uses GPIO22 for Z, while Yakara's uses GPIO33

        config BLUN64_PINOUT_TYPE_ORIGINAL
            bool "Original"

        config BLUN64_PINOUT_TYPE_YAKARA
            bool "Yakara's"
    endchoice

endmenu
```
